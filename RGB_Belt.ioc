# file: RGB_Belt.ioc
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Dma.Request0=TIM1_CH3
Dma.TIM1_CH3.0.Direction=DMA_MEMORY_TO_PERIPH
Dma.TIM1_CH3.0.Instance=DMA1_Channel6
Dma.TIM1_CH3.0.MemDataAlignment=DMA_MDATAALIGN_HALFWORD
Dma.TIM1_CH3.0.MemInc=DMA_MINC_ENABLE
Dma.TIM1_CH3.0.Mode=DMA_CIRCULAR
Dma.TIM1_CH3.0.PeriphDataAlignment=DMA_PDATAALIGN_HALFWORD
Dma.TIM1_CH3.0.PeriphInc=DMA_PINC_DISABLE
Dma.TIM1_CH3.0.Priority=DMA_PRIORITY_LOW
Mcu.Family=STM32F1
Mcu.Name=STM32F103C(8-B)Tx
Mcu.Package=LQFP48
NVIC.DMA1_Channel6_IRQn=true\:0\:0\:false\:false\:true\:false\:true
NVIC.PriorityGroup=NVIC_PRIORITYGROUP_4
PA10.GPIO_Speed=GPIO_SPEED_FREQ_HIGH
PA10.Signal=S_TIM1_CH3
PA13.Mode=Serial_Wire
PA13.Signal=SYS_JTMS-SWDIO
PA14.Mode=Serial_Wire
PA14.Signal=SYS_JTCK-SWCLK
PD0-OSC_IN.Mode=HSE-External-Oscillator
PD0-OSC_IN.Signal=RCC_OSC_IN
PD1-OSC_OUT.Mode=HSE-External-Oscillator
PD1-OSC_OUT.Signal=RCC_OSC_OUT
ProjectManager.HeapSize=0x200
ProjectManager.StackSize=0x400
ProjectManager.TargetToolchain=MDK-ARM V5
RCC.AHBFreq_Value=72000000
RCC.APB1CLKDivider=RCC_HCLK_DIV2
RCC.APB1Freq_Value=36000000
RCC.APB1TimFreq_Value=72000000
RCC.APB2Freq_Value=72000000
RCC.APB2TimFreq_Value=72000000
RCC.HCLKFreq_Value=72000000
RCC.PLLMUL=RCC_PLL_MUL9
RCC.PLLSourceVirtual=RCC_PLLSOURCE_HSE
RCC.SYSCLKFreq_VALUE=72000000
RCC.SYSCLKSource=RCC_SYSCLKSOURCE_PLLCLK
RCC.USBFreq_Value=72000000
SH.S_TIM1_CH3.0=TIM1_CH3,PWM Generation3 CH3
TIM1.Channel-PWM\ Generation3\ CH3=TIM_CHANNEL_3
TIM1.Period=80
board=custom

// file: Core/Src/main.c
/* USER CODE BEGIN Header */
/**
  ******************************************************************************
  * @file           : main.c
  * @brief          : Main program body
  ******************************************************************************
  * @attention
  *
  * <h2><center>&copy; Copyright (c) 2021 STMicroelectronics.
  * All rights reserved.</center></h2>
  *
  * This software component is licensed by ST under BSD 3-Clause license,
  * the "License"; You may not use this file except in compliance with the
  * License. You may obtain a copy of the License at:
  *                        opensource.org/licenses/BSD-3-Clause
  *
  ******************************************************************************
  */
/* USER CODE END Header */
#include "main.h"

/* USER CODE BEGIN Includes */
#include "ws2812.h"
/* USER CODE END Includes */

TIM_HandleTypeDef htim1;
DMA_HandleTypeDef hdma_tim1_ch3;

void SystemClock_Config(void);
static void MX_GPIO_Init(void);
static void MX_DMA_Init(void);
static void MX_TIM1_Init(void);

/* USER CODE BEGIN 0 */
void display0(void)
{
	uint8_t number = 0;
	uint8_t mode = 0;
	uint16_t counter = 0;

	while(counter < 1)
	{
		switch(mode)
		{
			case 0:ws2812_set_one_led_color(WS2812_Color_Red, number);
				break;
			case 1:ws2812_set_one_led_color(WS2812_Color_Green, number);
				break;
			case 2:ws2812_set_one_led_color(WS2812_Color_Blue, number);
				break;
			case 3:ws2812_set_one_led_color(WS2812_Color_Yellow, number);
				break;
			case 4:ws2812_set_one_led_color(WS2812_Color_White, number);
				break;
			case 5:ws2812_set_one_led_color(WS2812_Color_Black, number);
				break;
			case 6:ws2812_set_one_led_color(WS2812_Color_Snow, number);
				break;
			case 7:ws2812_set_one_led_color(WS2812_Color_NavyBlue, number);
				break;
			case 8:ws2812_set_one_led_color(WS2812_Color_LightSkyBlue, number);
				break;
			case 9:ws2812_set_one_led_color(WS2812_Color_DarkGreen, number);
				break;
			case 10:ws2812_set_one_led_color(WS2812_Color_Orange, number);
				break;
			case 11:ws2812_set_one_led_color(WS2812_Color_DeepPink, number);
				break;
			case 12:ws2812_set_one_led_color(WS2812_Color_DarkGrey, number);
				break;
		}

		HAL_Delay(20);
		number++;
		if(number >= WS2812_LED_NUMBER)
		{
			number = 0;
			mode++;
			if(mode > 12)
			{
				mode = 0;
				counter++;
			}
		}
	}

	ws2812_set_all_led_color(WS2812_Color_Black);
}

void display1(void)
{
	uint8_t number = 0;
	uint8_t mode = 0;
	uint8_t red = 0xff;
	uint8_t green = 0x00;
	uint8_t blue = 0x00;
	uint8_t *pdata = &red;
	uint16_t counter = 0;

	while(counter < 3)
	{
		ws2812_set_all_led_rgb(red, green, blue);

		if(mode == 0)
		{
			if(*pdata + 2 < 0xff)
				*pdata += 2;
			else
			{
				mode = 1;
				number++;
				*pdata -= 2;
			}
		}
		else
		{
			if(*pdata - 2 > 0)
				*pdata -= 2;
			else
			{
				number++;
				mode = 0;
				*pdata += 2;
			}
		}

		if(number > 2)
		{
			number = 0;
			counter++;
			if(pdata == &red)
			{
				red = 0;
				pdata = &green;
			}
			else if(pdata == &green)
			{
				green = 0;
				pdata = &blue;
			}
			else
			{
				blue = 0;
				pdata = &red;
			}
		}

		HAL_Delay(20);
	}
}

void display2(void)
{
	uint8_t number = 0;
	uint16_t counter = 0;
	uint8_t mode = 0;
	WS2812_Color color = WS2812_Color_Red;

	ws2812_set_all_led_color(WS2812_Color_Black);
	ws2812_set_one_led_color(color, number);

	while(counter < 6)
	{
		HAL_Delay(100);
		ws2812_set_all_led_color(WS2812_Color_Black);
		ws2812_set_one_led_color(color, number);

		if(mode == 0)
		{
			number++;
			if(number >= WS2812_LED_NUMBER - 1)
			{
				mode = 1;
				counter++;
			}
		}
		else
		{
			number--;
			if(number == 0)
			{
				mode = 0;
				counter++;
				switch(color)
				{
					case WS2812_Color_Red:color = WS2812_Color_Green;
						break;
					case WS2812_Color_Green:color = WS2812_Color_Blue;
						break;
					case WS2812_Color_Blue:color = WS2812_Color_Red;
						break;
					default:
						color = WS2812_Color_Red;
						break;
				}
			}
		}
	}
}

/* USER CODE END 0 */

int main(void)
{

  /* MCU Configuration--------------------------------------------------------*/

  /* Reset of all peripherals, Initializes the Flash interface and the Systick. */
  HAL_Init();

  /* Configure the system clock */
  SystemClock_Config();

  /* Initialize all configured peripherals */
  MX_GPIO_Init();
  MX_DMA_Init();
  MX_TIM1_Init();
  /* USER CODE BEGIN 2 */

	ws2812_init();

  /* USER CODE END 2 */

  /* Infinite loop */
  /* USER CODE BEGIN WHILE */
  if (HAL_TIM_PWM_Start_DMA(&htim1, TIM_CHANNEL_3, (uint32_t *)WS2812_Buffer, (sizeof(WS2812_Buffer)/sizeof(WS2812_Buffer[0]))) != HAL_OK)
  {
    /* Starting Error */
    Error_Handler();
  }
  while (1)
  {
    /* USER CODE END WHILE */

    /* USER CODE BEGIN 3 */

		display0();
		display1();
		display2();

  }
  /* USER CODE END 3 */
}

void SystemClock_Config(void)
{
  RCC_OscInitTypeDef RCC_OscInitStruct = {0};
  RCC_ClkInitTypeDef RCC_ClkInitStruct = {0};

  /** Initializes the RCC Oscillators according to the specified parameters
  * in the RCC_OscInitTypeDef structure.
  */
  RCC_OscInitStruct.OscillatorType = RCC_OSCILLATORTYPE_HSE;
  RCC_OscInitStruct.HSEState = RCC_HSE_ON;
  RCC_OscInitStruct.HSEPredivValue = RCC_HSE_PREDIV_DIV1;
  RCC_OscInitStruct.HSIState = RCC_HSI_ON;
  RCC_OscInitStruct.PLL.PLLState = RCC_PLL_ON;
  RCC_OscInitStruct.PLL.PLLSource = RCC_PLLSOURCE_HSE;
  RCC_OscInitStruct.PLL.PLLMUL = RCC_PLL_MUL9;
  if (HAL_RCC_OscConfig(&RCC_OscInitStruct) != HAL_OK)
  {
    Error_Handler();
  }
  /** Initializes the CPU, AHB and APB buses clocks
  */
  RCC_ClkInitStruct.ClockType = RCC_CLOCKTYPE_HCLK|RCC_CLOCKTYPE_SYSCLK
                              |RCC_CLOCKTYPE_PCLK1|RCC_CLOCKTYPE_PCLK2;
  RCC_ClkInitStruct.SYSCLKSource = RCC_SYSCLKSOURCE_PLLCLK;
  RCC_ClkInitStruct.AHBCLKDivider = RCC_SYSCLK_DIV1;
  RCC_ClkInitStruct.APB1CLKDivider = RCC_HCLK_DIV2;
  RCC_ClkInitStruct.APB2CLKDivider = RCC_HCLK_DIV1;

  if (HAL_RCC_ClockConfig(&RCC_ClkInitStruct, FLASH_LATENCY_2) != HAL_OK)
  {
    Error_Handler();
  }
}

static void MX_TIM1_Init(void)
{

  TIM_MasterConfigTypeDef sMasterConfig = {0};
  TIM_OC_InitTypeDef sConfigOC = {0};
  TIM_BreakDeadTimeConfigTypeDef sBreakDeadTimeConfig = {0};

  htim1.Instance = TIM1;
  htim1.Init.Prescaler = 0;
  htim1.Init.CounterMode = TIM_COUNTERMODE_UP;
  htim1.Init.Period = 80;
  htim1.Init.ClockDivision = TIM_CLOCKDIVISION_DIV1;
  htim1.Init.RepetitionCounter = 0;
  htim1.Init.AutoReloadPreload = TIM_AUTORELOAD_PRELOAD_DISABLE;
  if (HAL_TIM_PWM_Init(&htim1) != HAL_OK)
  {
    Error_Handler();
  }
  sMasterConfig.MasterOutputTrigger = TIM_TRGO_RESET;
  sMasterConfig.MasterSlaveMode = TIM_MASTERSLAVEMODE_DISABLE;
  if (HAL_TIMEx_MasterConfigSynchronization(&htim1, &sMasterConfig) != HAL_OK)
  {
    Error_Handler();
  }
  sConfigOC.OCMode = TIM_OCMODE_PWM1;
  sConfigOC.Pulse = 0;
  sConfigOC.OCPolarity = TIM_OCPOLARITY_HIGH;
  sConfigOC.OCNPolarity = TIM_OCNPOLARITY_HIGH;
  sConfigOC.OCFastMode = TIM_OCFAST_DISABLE;
  sConfigOC.OCIdleState = TIM_OCIDLESTATE_RESET;
  sConfigOC.OCNIdleState = TIM_OCNIDLESTATE_RESET;
  if (HAL_TIM_PWM_ConfigChannel(&htim1, &sConfigOC, TIM_CHANNEL_3) != HAL_OK)
  {
    Error_Handler();
  }
  sBreakDeadTimeConfig.OffStateRunMode = TIM_OSSR_DISABLE;
  sBreakDeadTimeConfig.OffStateIDLEMode = TIM_OSSI_DISABLE;
  sBreakDeadTimeConfig.LockLevel = TIM_LOCKLEVEL_OFF;
  sBreakDeadTimeConfig.DeadTime = 0;
  sBreakDeadTimeConfig.BreakState = TIM_BREAK_DISABLE;
  sBreakDeadTimeConfig.BreakPolarity = TIM_BREAKPOLARITY_HIGH;
  sBreakDeadTimeConfig.AutomaticOutput = TIM_AUTOMATICOUTPUT_DISABLE;
  if (HAL_TIMEx_ConfigBreakDeadTime(&htim1, &sBreakDeadTimeConfig) != HAL_OK)
  {
    Error_Handler();
  }
  HAL_TIM_MspPostInit(&htim1);

}

static void MX_DMA_Init(void)
{

  /* DMA controller clock enable */
  __HAL_RCC_DMA1_CLK_ENABLE();

  /* DMA interrupt init */
  /* DMA1_Channel6_IRQn interrupt configuration */
  HAL_NVIC_SetPriority(DMA1_Channel6_IRQn, 0, 0);
  HAL_NVIC_EnableIRQ(DMA1_Channel6_IRQn);

}

static void MX_GPIO_Init(void)
{

  /* GPIO Ports Clock Enable */
  __HAL_RCC_GPIOD_CLK_ENABLE();
  __HAL_RCC_GPIOA_CLK_ENABLE();

}

void Error_Handler(void)
{
  __disable_irq();
  while (1)
  {
  }
}

/************************ (C) COPYRIGHT STMicroelectronics *****END OF FILE****/
